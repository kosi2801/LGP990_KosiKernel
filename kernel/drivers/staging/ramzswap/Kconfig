## kernel/drivers/staging/ramzswap/Kconfig
```kconfig
config RAMZSWAP
	tristate "Compressed in-memory swap device (ramzswap)"
	depends on SWAP
	default n
	help
	  Creates virtual block devices which can (only) be used as swap
	  disks. Pages swapped to these disks are compressed and stored in
	  memory itself.

	  See ramzswap.txt for more information.
	  Project home: http://compcache.googlecode.com/
	  Modded by kosi2801 to use buildin Snappy compression instead of LZO.

config RAMZSWAP_STATS
	bool "Enable ramzswap stats"
	depends on RAMZSWAP
	default y
	help
	  Enable statistics collection for ramzswap. This adds only a minimal
	  overhead. In unsure, say Y.

config RAMZSWAP_OLD_COMPRESSION
	bool "Use old LZO compression algorithm instead of Snappy for ramzswap"
	depends on RAMZSWAP
        select LZO_COMPRESS
        select LZO_DECOMPRESS
	default y
	help
	  This replaces the default Snappy compression of the ramzswap device 
	  with the slower but more efficient LZO algorithm. 
	  In unsure, say Y.
```

## kernel/drivers/staging/zram/Kconfig
```kconfig
config XVMALLOC
	bool
	default n

config ZRAM
	tristate "Compressed RAM block device support"
	depends on BLOCK
	select NOTIFY_PAGE_FREE
	default n
	help
	  Creates virtual block devices called /dev/zramX (X = 0, 1, ...).
	  Pages written to these disks are compressed and stored in memory
	  itself. These disks allow very fast I/O and compression provides
	  good amounts of memory savings.

	  It has several use cases, for example: /tmp storage, use as swap
	  disks and maybe many more.

	  See zram.txt for more information.
	  Project home: http://compcache.googlecode.com/

config ZRAM_OLD_COMPRESSION
        bool "Use old LZO compression algorithm instead of Snappy for zram"
        depends on ZRAM
        select LZO_COMPRESS
        select LZO_DECOMPRESS
        default y
        help
          This replaces the default Snappy compression of the zram device 
          with the slower but more efficient LZO algorithm. 
          In unsure, say Y.

config ZCACHE
	bool "Page cache compression support"
	depends on CLEANCACHE
	select XVMALLOC
	select LZO_COMPRESS
	select LZO_DECOMPRESS
	default n
	help
	  Compresses relatively unused page cache pages and stores them in
	  memory itself. This increases effective memory size and can help
	  reduce access to backing store device(s) which is typically much
	  slower than access to main memory.

	  Statistics are expoted through sysfs interface:
	  /sys/kernel/mm/zcache/

	  Project home: http://compcache.googlecode.com/
```
